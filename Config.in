## Config.in
```kconfig
config BR2_PACKAGE_PYTHON_RSA
        bool "python-rsa"
        help
          Python-RSA is a pure-Python RSA implementation. It supports
          encryption and decryption, signing and verifying signatures,
          and key generation according to PKCS#1 version 1.5. It can be
          used as a Python library as well as on the commandline. The code
          was mostly written by Sybren A. Stüvel.

          Documentation can be found at the Python-RSA homepage:
          http://stuvel.eu/rsa
```
